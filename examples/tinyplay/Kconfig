## examples/tinyplay/Kconfig
```kconfig
#
# For a description of the syntax of this configuration file,
# see the file kconfig-language.txt in the NuttX tools repository.
#

config EXAMPLES_TINYPLAY
	bool "tiny audio player"
	default n
	depends on I2S && AUDIO && DRIVERS_AUDIO && AUDIO_I2SCHAR
	---help---
		Enable the tiny audio player

if EXAMPLES_TINYPLAY

config EXAMPLES_TINYPLAY_PROGNAME
	string "Program name"
	default "tinyplay"

config EXAMPLES_TINYPLAY_PRIORITY
	int "Tinyplay task priority"
	default 140

config EXAMPLES_TINYPLAY_STACKSIZE
	int "Tinyplay stack size"
	default DEFAULT_TASK_STACKSIZE

config EXAMPLES_TINYPLAY_HTTP_SUPPORT
	bool "Include support for http streaming"
	default n
	depends on NET_TCP
	---help---
		When enabled, this feature will add code to enable HTTP
		audio streaming as well as local file playback.

endif
```

## testing/cstest/Kconfig
```kconfig
#
# For a description of the syntax of this configuration file,
# see the file kconfig-language.txt in the NuttX tools repository.
#

config TESTING_CSTEST
	tristate "cstest example"
	default n
	---help---
		Enable the cstest example.

if TESTING_CSTEST

config TESTING_CSTEST_PROGNAME
	string "Program name"
	default "cstest"
	---help---
		This is the name of the program that will be used when the NSH ELF
		program is installed.

config TESTING_CSTEST_PRIORITY
	int "cstest task priority"
	default 100

config TESTING_CSTEST_STACKSIZE
	int "cstest stack size"
	default DEFAULT_TASK_STACKSIZE

endif
```
